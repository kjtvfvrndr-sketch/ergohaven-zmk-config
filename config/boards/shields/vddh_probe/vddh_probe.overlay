/*
 * Временный диагностический шилд. Не для повседневных сборок.
 * Переводит замер батареи на внутренний тап VDDHDIV5 nRF52840 —
 * внешний делитель не участвует вообще.
 *
 * vbatt гасим намеренно: оба драйвера настраивают SAADC channel_id 0,
 * при двух живых узлах второй init перетирает конфиг первого.
 */

&vbatt {
    status = "disabled";
};

/ {
    chosen {
        zmk,battery = &vddh;
    };

    vddh: vddh {
        status = "okay";
        compatible = "zmk,battery-nrf-vddh";
    };
};