#include "k04_micro.dtsi"

/*
 * Пины из [split.central.matrix] в keyboard.toml.
 * Соответствие RMK -> ZMK проверено на op36: там RMK row_pins/col_pins
 * совпадают с ZMK row-gpios/col-gpios ПИН-В-ПИН и в том же порядке.
 * R2..R5 = P0.28, P0.03, P1.10, P1.11 (ряд R1 у Micro отсутствует)
 * C1..C6 = P1.06, P1.04, P1.02, P1.00, P0.22, P0.20
 */
&kscan0 {
    compatible = "zmk,kscan-gpio-matrix";

    col-gpios
        = <&gpio1 6 GPIO_ACTIVE_HIGH>
        , <&gpio1 4 GPIO_ACTIVE_HIGH>
        , <&gpio1 2 GPIO_ACTIVE_HIGH>
        , <&gpio1 0 GPIO_ACTIVE_HIGH>
        , <&gpio0 22 GPIO_ACTIVE_HIGH>
        , <&gpio0 20 GPIO_ACTIVE_HIGH>
        ;

    row-gpios
        = <&gpio0 28 (GPIO_ACTIVE_HIGH | GPIO_PULL_DOWN)>
        , <&gpio0 3  (GPIO_ACTIVE_HIGH | GPIO_PULL_DOWN)>
        , <&gpio1 10 (GPIO_ACTIVE_HIGH | GPIO_PULL_DOWN)>
        , <&gpio1 11 (GPIO_ACTIVE_HIGH | GPIO_PULL_DOWN)>
        ;
};

/* Левый модульный отсек: энкодер. Если там трекбол/тачпад или пусто —
   удалите этот блок, позиция 36 просто никогда не сработает. */
&encoder_L1 {
    status = "okay";
};
