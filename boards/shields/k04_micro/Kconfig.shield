## boards/shields/k04_micro/Kconfig.shield
```kconfig
config SHIELD_K04_MICRO_LEFT
    def_bool $(shields_list_contains,k04_micro_left)

config SHIELD_K04_MICRO_RIGHT
    def_bool $(shields_list_contains,k04_micro_right)
```

## config/boards/shields/k04_micro/Kconfig.defconfig
```kconfig
if SHIELD_K04_MICRO_RIGHT

config ZMK_KEYBOARD_NAME
    default "EH K04 Micro"

config ZMK_SPLIT_ROLE_CENTRAL
    default y

config ZMK_POINTING
    default y

endif

if SHIELD_K04_MICRO_LEFT

config ZMK_KEYBOARD_NAME
    default "EH K04 Micro"

endif

if SHIELD_K04_MICRO_LEFT || SHIELD_K04_MICRO_RIGHT

config ZMK_SPLIT
    default y

endif
```

## config/west.yml
```yaml
manifest:
  remotes:
    - name: ergohaven
      url-base: https://github.com/ergohaven
    - name: oleksandrmaslov
      url-base: https://github.com/oleksandrmaslov
    - name: kjtvfvrndr-sketch
      url-base: https://github.com/kjtvfvrndr-sketch
    - name: kot149
      url-base: https://github.com/kot149
  projects:
    - name: ergohaven-zmk
      remote: ergohaven
      revision: main
      import: config/west.yml
    - name: zmk-pmw3610-driver
      remote: kjtvfvrndr-sketch
      revision: main
    - name: zmk-pointing-acceleration
      remote: oleksandrmaslov
      revision: main
    - name: zmk-temp-layer-keep
      remote: kjtvfvrndr-sketch
      revision: main
    - name: zmk-mouse-gesture
      remote: kot149
      revision: v1
    - name: zmk-rgbled-widget
      remote: kjtvfvrndr-sketch
      revision: main
  self:
    path: config
```
